## conf/distro/include/container-image-packagelists.inc
```bitbake
#
# List of the container-image recipes in meta-virt
#

CONTAINER_IMAGES_META_VIRT = "\
    container-base \
    app-container-curl \
    app-container-mosquitto \
    app-container-nginx \
    app-container-python \
    app-container-valkey \
"
```
